## config/west.yml
```yaml
manifest:
  defaults:
    revision: v0.3
  remotes:
    - name: zmkfirmware
      url-base: https://github.com/zmkfirmware
    # Additional modules containing boards/shields/custom code can be listed here as well
    # See https://docs.zephyrproject.org/3.2.0/develop/west/manifest.html#projects
  projects:
    - name: zmk
      remote: zmkfirmware
      import: app/west.yml
    - name: zmk-config-charybdis
      url: https://github.com/choovick/zmk-config-charybdis.git
      revision: main
      path: modules/zmk-config-charybdis
    - name: zmk-for-charybdis
      url: https://github.com/HeeTuic/zmk-for-charybdis.git
      revision: master
      path: modules/zmk-for-charybdis
  self:
    path: config
```
